## config/Kconfig
```kconfig
#
# Copyright (c) 2022 The ZMK Contributors
# SPDX-License-Identifier: MIT
#
config ZMK_DISPLAY_FULL_REFRESH_PERIOD
    int "(Optional) Period to issue a full refresh to the display (in seconds)"
    default 0
    help
      Period in seconds for how often to completely refresh/redraw the whole screen.
      Most useful for e-ink/EPD displays that require occasional full redraws.

config BOARD_CORNEISH_ZEN_LEFT
    bool

config BOARD_CORNEISH_ZEN_RIGHT
    bool
```
